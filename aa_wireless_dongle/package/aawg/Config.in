## aa_wireless_dongle/package/aawg/Config.in
```kconfig
config BR2_PACKAGE_AAWG
	bool "aawg"
	depends on BR2_USE_MMU # dbus-cxx-custom, protobuf
	depends on BR2_INSTALL_LIBSTDCPP
	depends on BR2_TOOLCHAIN_HAS_THREADS
	depends on BR2_TOOLCHAIN_GCC_AT_LEAST_8 # protobuf
	depends on !BR2_STATIC_LIBS # dbus-cxx-custom, protobuf
	depends on BR2_PACKAGE_PROTOBUF_ARCH_SUPPORTS
	select BR2_PACKAGE_DBUS_CXX_CUSTOM
	select BR2_PACKAGE_PROTOBUF
	help
	  Android Auto Wireless Gateway Daemon
```
